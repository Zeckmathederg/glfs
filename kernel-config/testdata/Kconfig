## kernel-config/testdata/Kconfig
```kconfig
menu "Master section"

menu "Subsection"

config REQU_PAR
	bool "Required parameter"

config REQU_PAR_NMOD
	tristate "Required parameter (not as module)"

config REQU_PAR_MOD
	tristate "Required parameter (could be a module)"

config REQU_PAR_MOD_ONLY
	tristate "Required parameter (as a module)"

config OPT_PAR
	tristate "Optional parameter"

config OPT_PAR_MOD_ONLY
	tristate "Optional parameter (as a module if enabled)"

config INCOMP_PAR
	bool "Incompatible parameter"

config INCOMP_PAR_MOD
	tristate "Incompatible parameter (even as module)"

endmenu # subsection

endmenu # master section
```
